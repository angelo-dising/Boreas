#include<Arduino.h>
#include <Wire.h>
#include "MQ135.h"
#include <Adafruit_GFX.h>
#include <Adafruit_SSD1306.h>
#define PIN_MQ135 34
float temperature = 21.0; // assume current temperature. Recommended to measure with DHT22
float humidity = 25.0; // assume current humidity. Recommended to measure with DHT22
MQ135 mq135_sensor = MQ135(PIN_MQ135);
#define SCREEN_WIDTH 128 // OLED display width, in pixels
#define SCREEN_HEIGHT 32 // OLED display height, in pixels
Adafruit_SSD1306 display(SCREEN_WIDTH, SCREEN_HEIGHT, &Wire, -1);
bool Sensor_ausente = false;
void NO_sensor_atached(){
Serial.println("Air sensor not detected. Please check wiring. Freezing...");
delay(2000);
// 'nosensor', 128x32px
// 'nosensor', 128x32px
display.stopscroll();

const unsigned char nolifenosensor [] PROGMEM = {
	0x00, 0x00, 0x00, 0x00, 0x00, 0x00, 0x00, 0x00, 0x00, 0x00, 0x00, 0x00, 0x00, 0x00, 0x00, 0x00, 
	0x00, 0x00, 0x00, 0x00, 0x00, 0x00, 0x00, 0x00, 0x00, 0x00, 0x00, 0x00, 0x00, 0x00, 0x00, 0x00, 
	0x00, 0x00, 0x00, 0x00, 0x00, 0x00, 0x00, 0x00, 0x00, 0x00, 0x00, 0x00, 0x00, 0x00, 0x00, 0x00, 
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	0x00, 0x00, 0x00, 0x00, 0x00, 0x00, 0x00, 0x00, 0x00, 0x00, 0x00, 0x00, 0x00, 0x00, 0x00, 0x00
};
display.clearDisplay();
display.setTextSize(2);
display.setTextColor(WHITE);
display.setCursor(0, 0);
// Display static text
display.drawBitmap(0,0,nolifenosensor,128,32,1);
display.display();
delay(1000);

const unsigned char nolifenosensor2 [] PROGMEM = {
	0xff, 0xff, 0xff, 0xff, 0xff, 0xff, 0xff, 0xff, 0xff, 0xff, 0xff, 0xff, 0xff, 0xff, 0xff, 0xff, 
	0xff, 0xff, 0xff, 0xff, 0xff, 0xff, 0xff, 0xff, 0xff, 0xff, 0xff, 0xff, 0xff, 0xff, 0xff, 0xff, 
	0xff, 0xff, 0xff, 0xff, 0xff, 0xff, 0xff, 0xff, 0xff, 0xff, 0xff, 0xff, 0xff, 0xff, 0xff, 0xff, 
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	0xff, 0xff, 0xff, 0xff, 0xff, 0xff, 0xff, 0xff, 0xff, 0xff, 0xff, 0xff, 0xff, 0xff, 0xff, 0xff
};
display.clearDisplay();
display.setTextSize(2);
display.setTextColor(WHITE);
display.setCursor(0, 0);
// Display static text
display.drawBitmap(0,0,nolifenosensor2,128,32,1);
display.display(); 
delay(1000);

display.startscrollleft(0x00, 0x0F);
const unsigned char nolife [] PROGMEM = {
	0x00, 0x00, 0x00, 0x00, 0x00, 0x00, 0x00, 0x03, 0x80, 0x00, 0x00, 0x00, 0x00, 0x00, 0x00, 0x00, 
	0x00, 0x00, 0x00, 0x00, 0x00, 0x00, 0x00, 0x03, 0x80, 0x00, 0x00, 0x00, 0x00, 0x00, 0x00, 0x00, 
	0x00, 0x00, 0x00, 0x00, 0x00, 0x00, 0x00, 0x07, 0xc0, 0x00, 0x00, 0x00, 0x00, 0x00, 0x00, 0x00, 
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	0x00, 0x00, 0x00, 0x00, 0x00, 0x03, 0xff, 0xff, 0xff, 0xff, 0xc0, 0x00, 0x00, 0x00, 0x00, 0x00
};
display.clearDisplay();
display.setTextSize(2);
display.setTextColor(WHITE);
display.setCursor(0, 0);
// Display static text
display.drawBitmap(0,0,nolife,128,32,1);
display.display(); 
delay(10000);
Sensor_ausente = true;
 if(Sensor_ausente == true)esp_restart();
}
float euler_number = 2.71828182;
float euler_number_negative = 0.36787944117;
float Temperature = 0;
float Humedad = 0;
float co2_outdoor = 400;
float co2_peack = 0;
float co2_diference = 0;
float Decay63_percentage = 0;
float time63_percentage = 0;
float ventilation_rate = 0;
int  minute_max_peack = 61 ;
int minute_decay = 60;
int Ventilation_Rate = 0 ;
float probability = 0;
float quanta_inhaled_per_person = 0;
float average_quanta_concentration = 0;
float Breathing_rate = 0.318; //el numero debe de ser cambiado si se sabe lo que se hace, el valor es valido para alumnos de 16-21 
float Mask_eficiency = 30;//si se conoce la eficiencia de la masacara y se establece que todos tengan la misma, se pude cambiar
float Net_emission_Rate = 0;
float Total_order_loss_rate = 0;
float volume = 200;//se debe de cambiar dependiendo del salon, debe de ser m3
float Quanta_Exalation_rate_of_posible_infected = 2.0;
const unsigned char logoboraslogo [] PROGMEM = {
	0x00, 0x00, 0x00, 0x00, 0x00, 0x00, 0x00, 0x00, 0x00, 0x00, 0x00, 0x00, 0x00, 0x00, 0x00, 0x00, 
	0x00, 0x00, 0x00, 0x00, 0x00, 0x00, 0x00, 0x00, 0x00, 0x00, 0x00, 0x00, 0x00, 0x00, 0x00, 0x00, 
	0x00, 0x00, 0x00, 0x00, 0x00, 0x00, 0x00, 0x00, 0x00, 0x00, 0x00, 0x00, 0x00, 0x00, 0x00, 0x00, 
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	0x00, 0x00, 0x00, 0x00, 0x00, 0x00, 0x00, 0x00, 0x00, 0x00, 0x00, 0x00, 0x00, 0x00, 0x00, 0x00
};
void setup() {

#define I2C_SDA 22
#define I2C_SCL 19
Wire.begin(22,I2C_SCL);
//SSD1306 display(0x3c, 21, 22);
Serial.begin(115200);
delay(100);
 if(!display.begin(SSD1306_SWITCHCAPVCC, 0x3C)) { 
  Serial.println("SSD1306 allocation failed");
  for(;;); // Don't proceed, loop forever
}
// 'boeas logo2', 128x32px


display.clearDisplay();
display.setTextSize(2);
display.setTextColor(WHITE);
display.setCursor(0, 0);
// Display static text
display.drawBitmap(0,0,logoboraslogo,128,32,1);
display.display(); 
delay(100);
///////////////////////////////////////////////////////////////////////////////
if(analogRead(34) == 0){
NO_sensor_atached();
}
////////////////////////////////////////////////////////////////////////////////

}
void loop() {
 float rzero = mq135_sensor.getRZero();
  float correctedRZero = mq135_sensor.getCorrectedRZero(temperature, humidity);
  float resistance = mq135_sensor.getResistance();
  float ppm = mq135_sensor.getPPM();
  float correctedPPM = mq135_sensor.getCorrectedPPM(temperature, humidity);

  Serial.print("MQ135 RZero: ");
  Serial.print(rzero);
  Serial.print("\t Corrected RZero: ");
  Serial.print(correctedRZero);
  Serial.print("\t Resistance: ");
  Serial.print(resistance);
  Serial.print("\t PPM: ");
  Serial.print(ppm);
  Serial.print("\t Corrected PPM: ");
  Serial.print(correctedPPM);
  Serial.println("ppm");
  delay(1000);
  Serial.print("co2(ppm):");
  Serial.print(correctedPPM);
  delay(2000);
  display.clearDisplay();
  display.setTextSize(1);
  display.setTextColor(WHITE);
  display.setCursor(0, 0);
  // Display static text
  display.print("CO2 : ");
  display.print(correctedPPM);
  display.display(); 
  display.setTextSize(1);
  display.setTextColor(WHITE);

  delay(1000);
  if(analogRead(34) == 0 || analogRead(34) >1024){
NO_sensor_atached();
}
co2_diference = co2_peack - co2_outdoor;
Serial.print(co2_diference); 
Decay63_percentage = co2_outdoor + (euler_number_negative * co2_diference);
Serial.print(Decay63_percentage); 

ventilation_rate = 60;
Serial.print(ventilation_rate); 

Total_order_loss_rate = ventilation_rate + 0.62 + 0.3;
Serial.print(Total_order_loss_rate); 

Net_emission_Rate = Quanta_Exalation_rate_of_posible_infected *(1-Mask_eficiency*100)*1;
Serial.print(Net_emission_Rate); 

average_quanta_concentration = Net_emission_Rate/Total_order_loss_rate/volume*(1-(1-Total_order_loss_rate/1)*(1-pow(euler_number,Total_order_loss_rate)));
Serial.print(average_quanta_concentration); 

quanta_inhaled_per_person = average_quanta_concentration * Breathing_rate * 1 * (1 - Mask_eficiency * 100);
Serial.print(quanta_inhaled_per_person); 

probability = (1-(pow(euler_number,(quanta_inhaled_per_person))));
Serial.print(probability); 

}
