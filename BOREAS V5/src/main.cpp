#include<Arduino.h>
#include <Wire.h>
#include "SparkFun_SCD30_Arduino_Library.h"
#include <Adafruit_GFX.h>
#include <Adafruit_SSD1306.h>
#define SCREEN_WIDTH 128 
#define SCREEN_HEIGHT 32 
	int button1 = 21;
	int button2 = 19;
	int button3 = 18; 
	int w = 0;//No cambiar
	int e = 0;//No cambiar	
	int People_in_the_room = 1;
	int menu_selector = 0;
	int personas_con_mascara = 100;
	int selector = 0;
	float CO2_generation_rate = 0.1348;
	float euler_number = 2.71828182;	//NO CAMBIAR NI USAR #DEFINE de otra forma no funcionara
	float euler_number_negative = 0.36787944117;	//NO CAMBIAR NI USAR #DEFINE de otra forma no funcionara
	float CO2 = 0; //Particulas por millon NO CAMBIAR VALOR⚠
	float Temperature = 0;//Temperatura NO CAMBIAR VALOR⚠
	float Humedad = 0;//Humedad NO CAMBIAR VALOR ⚠
	float co2_outdoor = 400;/*Si tienes un valor mas acercado cambiar con precaucion solo es la cantidad de 
	co2 que hay afuera, normalmente solo es entre 412 y 420*/
	float co2_peack = 0;//Cantidad maxima de co2 detectada es usada para calibrar el sensor y proximamente calibracion pasiva y continua NO
	//NO CAMBIAR VALOR ⚠
	float co2_diference = 0;//Diferencia de co2 entre el co2 de el exterior y el interior NO CAMBIAR ⚠
	float Decay63_percentage = 0;//Variable usada para calibrar NO CAMBIAR ⚠
	float decay63time = 0;//Variable usada para calibrar NO CAMBIAR ⚠
	float ventilation_rate = 2;//Variable usada para estimar probabilidad NO CAMBIAR ⚠
	float Probabilidad = 0;//Variable que almacena la probabilidad NO CAMBIAR ⚠
	float quanta_inhaled_per_person = 0;//Variable usada para estimar probabilidad NO CAMBIAR ⚠
	float average_quanta_concentration = 0;//Variable usada para estimar probabilidad NO CAMBIAR ⚠
	float Breathing_rate = 0.52; //Cambiar dependiendo de las personas que hay en la habitacion, ⚠ CONSULTAR INFORMACION EN EL README!!!
	float Mask_eficiency = 0;//Se debe de obtener el dato de la eficiencia de la mascara que las personas usan!!
	float Inhalation_mask_eficiency = 0.3;//Se debe de obtener el dato de la eficiencia de la mascara que las personas usan!!
	float People_whit_mask = 1;//Porcentaje de personas con mascara siendo 1 el 100% 0.5 el 50% etc..
	float Net_emission_Rate = 0;//Variable usada para estimar probabilidad NO CAMBIAR ⚠
	float Total_order_loss_rate = 0;//Variable usada para estimar probabilidad NO CAMBIAR ⚠
	float volume = 200;//se debe estimar el volumen de la habitacion en la que se va a estar, ES UNA VARIABLE IMPORTANTE !!!⚠
	float volume_csq = volume *  35.315;
	float Quanta_Exalation_rate_of_posible_infected = 25;
	//⬆ Cambiar dependiendo de las personas que hay en la habitacion, ⚠ CONSULTAR INFORMACION EN EL README!!!
	float Event_Duration = 1;//Duracion de los sucesos que pasan en la habiatcion, la medida es en horas⚠
	float Time_past = 0;//Usado para calibrar NO CAMBIAR⚠
	




	bool a = false;//No cambiar

	bool Sensor_ausente = false;//No cambiar
	Adafruit_SSD1306 display(SCREEN_WIDTH, SCREEN_HEIGHT, &Wire, -1);/*Se usa para cambiar el tamaño de la pantalla usando SCREEN_WIDTH para
	el largo de la pantalla  y SCREEN_HEIGHT para la altura*/
	SCD30 airSensor;//Inicia el sensor de co2

	/*Los sigueinte arrays son bitmaps que contienen una imagen que se usa pra mostrar informacion en la pantalla
	como logos y texto pre diseñado, sientete libre de cambiar el bitmap a tu gusto usando la siguiente pagina: 
	https://javl.github.io/image2cpp/   En la que puedes transformar imagenes en bitmaps usables para la pantalla ssd1306
	no olvides que dependiendo de la version de pantalla que tienes debees cambiar el alto de la pantalla ya sea 128px por 32px
	o la version de 128px por 64px */ 
const unsigned char epd_bitmap_pixil_frame_0 [] PROGMEM = {
	0x00, 0x00, 0x00, 0x00, 0x00, 0x00, 0x00, 0x00, 0x00, 0x00, 0x00, 0x00, 0x00, 0x00, 0x00, 0x00, 
	0x1f, 0xff, 0xff, 0xfe, 0x00, 0x00, 0x00, 0x00, 0x00, 0x00, 0x00, 0x00, 0x00, 0x00, 0x00, 0x00, 
	0x20, 0x00, 0x00, 0x01, 0x00, 0x00, 0x00, 0x00, 0x00, 0x00, 0x00, 0x00, 0x00, 0x00, 0x00, 0x00, 
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	0x00, 0x00, 0x00, 0x00, 0x00, 0x00, 0x00, 0x00, 0x00, 0x00, 0x00, 0x00, 0x00, 0x00, 0x00, 0x00
};
const unsigned char BOREAS [] PROGMEM = {
	0x00, 0x00, 0x00, 0x00, 0x00, 0x00, 0x00, 0x00, 0x00, 0x00, 0x00, 0x00, 0x00,
	0x00, 0x00, 0x00, 0x00, 0x00, 0x00, 0x00, 0x00, 0x00, 0x00, 0x00, 0x00, 0x00, 
	0x00, 0x00, 0x00, 0x00, 0x00, 0x00, 0x00, 0x00, 0x00, 0x00, 0x00, 0x00, 0x00,
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	0x00, 0x00, 0x00, 0x00, 0x00};
const unsigned char NO_SENSOR_LOGO [] PROGMEM = {
	0x00, 0x00, 0x00, 0x00, 0x00, 0x00, 0x00, 0x00, 0x00, 0x00, 0x00, 0x00, 0x00,
	0x00, 0x00, 0x00, 0x00, 0x00, 0x00, 0x00, 0x00, 0x00, 0x00, 0x00, 0x00, 0x00, 
	0x00, 0x00, 0x00, 0x00, 0x00, 0x00, 0x00, 0x00, 0x00, 0x00, 0x00, 0x00, 0x00, 
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	0x00, 0x00, 0x00, 0x00, 0x00};

	char *menu_descripcion[5]{"Seleccionar el modelo de mascara","Iniciar mediciones","Personas totales","Personas con mascara","Probar sensores"};
	char *menu_options[5] {"MASK","START","PEOPLE","MASK.P","TEST"};
	char *mascaras_modelos[14] {"DL2 ","DL3 ","DS2 ","DS3","FFP2","FFP3","KN1000","KP95","KP1000","P2","P3","PFF2","PFF3","R95" };
	float breath_eficiency[14]  {0.5,0.6,0.7,0.8,0.9,0.3,0.99,0.95,0.99,0.8,0.9,0.98,0.5,0.95};

//Rutina que se encarga de mostrar los bitmaps que inican si el sensor no esta conectado a la placa
void No_Sensor_ (){	
		display.stopscroll();
		display.clearDisplay();
		display.setTextSize(2);
		display.setTextColor(WHITE);
		display.setCursor(0, 0);
		display.drawBitmap(0,0,NO_SENSOR_LOGO,128,32,1);
		display.display();
			delay(10000);
				Sensor_ausente = true;
 					if(Sensor_ausente == true)esp_restart();
}
//Rutina que estima de forma definitiva la proobabilidad de contagio
void Count_probability_(){
	delay(1000);
		while(digitalRead(button1) != true || digitalRead(button3) == true){
			if (airSensor.dataAvailable()){
				CO2 = airSensor.getCO2();
				ventilation_rate = 	((CO2_generation_rate * 60) /(volume_csq *(CO2-400)))*1000000;	
					
						//⬆⬆ calcula que tan rapido el aire cambia en la habitacion, es uno de los parametros mas importantes!
						Total_order_loss_rate = ventilation_rate + CO2_generation_rate + 0.3;
						Net_emission_Rate = Quanta_Exalation_rate_of_posible_infected *(1-(Mask_eficiency*People_whit_mask))*1;
						//⬆⬆calcula la emision de aerosoles  tomando en cuenta cuantas personas hay en la habitacion y la eficiencia de la mascara entre otros
						average_quanta_concentration = (Net_emission_Rate/Total_order_loss_rate/volume)*(1-(1/Total_order_loss_rate/Event_Duration)*(1-(pow(euler_number,-Total_order_loss_rate*Event_Duration))));
						//⬆⬆ alcula el promedio de las emisiones de las personas en la habiatacion
						quanta_inhaled_per_person = average_quanta_concentration * Breathing_rate * Event_Duration * (1 - (Inhalation_mask_eficiency * People_whit_mask));
						/*⬆⬆ Calcula cuantos aerosoles cada persona ha respirado en el intervalo y tomando en cuenta la eficiiencia de la mascara, la respiracion
						de las personas, la duraccion del evento etc..*/
						Probabilidad = (1-(pow(euler_number,(-quanta_inhaled_per_person))));
						/*⬆⬆A partir de resultado anterior determina la probabilidad*/
							display.clearDisplay();
							display.setTextSize(3);
							display.setTextColor(WHITE);
							display.setCursor(0, 0);
							display.print(Probabilidad);
							display.print("%");
							display.setCursor(0, 24);
							display.setTextSize(1);
							display.setTextColor(WHITE);
							display.print(CO2);
							display.print(" PPM");				
							display.display();
								delay(2000);}}
}

//Rutina que se encarga de calibrar el sensor que usa el co2 para estimar la velocidad que la habitacion cambia de aire (ACH)

//SETUP
void setup() {
	pinMode(button1,INPUT);//+
	pinMode(button2,INPUT);//✅
	pinMode(button3,INPUT);//-
	Wire.begin(23,22);//Configura el puerto I2C donde pin 23 es SDA Y PIN 22 SCL
	Serial.begin(115200);//⚠ VELOCIDAD DE PUERTO SERIAL ⚠
		if(!display.begin(SSD1306_SWITCHCAPVCC, 0x3C)) { 
			Serial.println("SSD1306 allocation failed");
				for(;;);}
					display.clearDisplay();
					display.setTextSize(2);
					display.setTextColor(WHITE);
					display.setCursor(0, 0);
					display.drawBitmap(0,0,BOREAS,128,32,1);
					display.display(); 
						delay(1000);
			if(airSensor.begin() == false)No_Sensor_();}

void loop() {
	for (int menu = 0; menu < 1;){
	display.clearDisplay();
	display.setTextSize(1);
	display.setTextColor(WHITE);
	display.setCursor(0, 0);
	display.print("MENU");
	display.setCursor(0, 11);
	display.setTextColor(WHITE);
	display.setTextSize(2);
	display.print(menu_options[menu_selector]);
    display.drawLine(0,31, 127, 31, WHITE);
	 display.drawLine(127,31, 127, 0, WHITE);
	  display.drawLine(25,0, 127, 0, WHITE);
	display.display();
			if(digitalRead(button2) == true && menu_selector == 0){
				delay(200);
           		for (int numero_mascara = 0; numero_mascara < 1;){
					display.clearDisplay();
					display.setTextSize(1);
					display.setTextColor(WHITE);
					display.setCursor(0, 0);
					display.print("MASK");
					display.setCursor(0, 11);
					display.setTextColor(WHITE);
					display.setTextSize(3);
					display.print(mascaras_modelos[selector]);
					display.display(); 
						if (digitalRead(button1) == HIGH){
								selector++;
								delay(200);
								if(selector == 14)selector = 0;
								}

						if (digitalRead(button3) == true){
								selector--;
					 			delay(200);
					 			if(selector == -1)selector = 13;
								 }

						if (digitalRead(button2) == true){
								Mask_eficiency = breath_eficiency[selector];
								numero_mascara++; 
								delay(500);
								}
}}

	if(digitalRead(button2) == true && menu_selector == 1){
		Count_probability_(); 
		delay(400);
		}


	if(digitalRead(button2) == true && menu_selector == 2){
		delay(200);
        	for (int numero_numero_de_personas = 0;numero_numero_de_personas < 1;){
				display.clearDisplay();
				display.setTextSize(1);
				display.setTextColor(WHITE);
				display.setCursor(0, 0);
				display.print("PEOPLE");
				display.setCursor(50, 11);
				display.setTextColor(WHITE);
				display.setTextSize(3);
				display.print(People_in_the_room);
				display.display(); 
					if (digitalRead(button1) == true ){
						People_in_the_room++;
						delay(100);} 

					if (digitalRead(button3) == true ){
						People_in_the_room--; 
						delay(500);}

					if(digitalRead(button2) == true){
						numero_numero_de_personas = 1;
						delay(1000);} 

						}}	

	if(digitalRead(button2) == true && menu_selector == 3){
		delay(400);
			for (int numero_numero_de_personas_con_mascara = 0;numero_numero_de_personas_con_mascara < 1;){
				display.clearDisplay();
				display.setTextSize(1);
				display.setTextColor(WHITE);
				display.setCursor(0, 0);
				display.print("MASK.P");
				display.setCursor(0, 11);
				display.setTextColor(WHITE);
				display.setTextSize(3);
				display.print(personas_con_mascara);
				display.print("%");
				display.display(); 
					if (digitalRead(button1) == true && People_whit_mask < 1.1){
						People_whit_mask = People_whit_mask + 0.1;
 						personas_con_mascara = personas_con_mascara + 10;
							if(People_whit_mask > 1 || personas_con_mascara > 100){
								People_whit_mask = 1;
								personas_con_mascara = 100;}
								delay(100);} 


					if (digitalRead(button3) == true ){
						People_whit_mask = People_whit_mask - 0.1; 
						personas_con_mascara = personas_con_mascara - 10;
							if(People_whit_mask < 0){
							People_whit_mask = 0;
							personas_con_mascara = 0;}
							delay(500);}

					if(digitalRead(button2) == true){
						numero_numero_de_personas_con_mascara = 1;
						delay(1000);}
}}

	if(digitalRead(button2) == true && menu_selector == 4){
 		delay(500);
			for(int test = 0;test < 1;){
                display.clearDisplay();
				display.setTextSize(1);
				display.setTextColor(WHITE);
				display.setCursor(96, 5);
				display.print("TEST");
				display.setCursor(0, 0);
				display.setTextColor(WHITE);
				display.setTextSize(1);
				display.print(airSensor.getCO2());
				display.print(" PPM");
				display.setCursor(0, 8);
				display.setTextColor(WHITE);
				display.setTextSize(1);
				display.print(airSensor.getHumidity());
				display.print(" %");
				display.setCursor(0, 16);
				display.setTextColor(WHITE);
				display.setTextSize(1);
				display.print(airSensor.getTemperature());
				display.print(" C");
				display.display(); 
					if (digitalRead(button2) == true){
						test = 1;
						delay(1000);}
					if (digitalRead(button1) == true){
						display.clearDisplay();
					display.setTextSize(2);
					display.setTextColor(WHITE);
					display.setCursor(0, 0);
					display.drawBitmap(0,0,epd_bitmap_pixil_frame_0,128,32,1);
					display.display();
						}
}}

if (digitalRead(button1) == true){ 
	menu_selector++;
	delay(400);
		if (menu_selector == 5)menu_selector = 0;}

if (digitalRead(button3) == true){ 
	menu_selector--;
	delay(400);
		if (menu_selector == -1)menu_selector = 4;}
}
}
